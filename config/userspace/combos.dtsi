// Copyright 2023 saikocat (@saikocat)
// SPDX-License-Identifier: MIT

#include "combos.h"

/ {
    combos {
        compatible = "zmk,combos";

// name, combo_bindings, keypos, combo_layers, combo_timeout

// Numpad
COMBO(num1,           &kp N0,            KPM_RB4 KPM_RH1,                 COMBO_LAYERS)
COMBO(num1,           &kp N1,            KPM_RB4 KPM_RB1,                 COMBO_LAYERS)
COMBO(num2,           &kp N2,            KPM_RB4 KPM_RB2,                 COMBO_LAYERS)
COMBO(num3,           &kp N3,            KPM_RB4 KPM_RB3,                 COMBO_LAYERS)
COMBO(num4,           &kp N4,            KPM_RB4 KPM_RM1,                 COMBO_LAYERS)
COMBO(num5,           &kp N5,            KPM_RB4 KPM_RM2,                 COMBO_LAYERS)
COMBO(num6,           &kp N6,            KPM_RB4 KPM_RM3,                 COMBO_LAYERS)
COMBO(num7,           &kp N7,            KPM_RB4 KPM_RT1,                 COMBO_LAYERS)
COMBO(num8,           &kp N8,            KPM_RB4 KPM_RT2,                 COMBO_LAYERS)
COMBO(num9,           &kp N9,            KPM_RB4 KPM_RT3,                 COMBO_LAYERS)

// Parenthesis, bracket, and brace
COMBO(lpar,           &kp LPAR,          KPM_LT3 KPM_LM1,                 COMBO_LAYERS)
COMBO(rpar,           &kp RPAR,          KPM_RT3 KPM_RM1,                 COMBO_LAYERS)
COMBO(lbkt,           &kp LBKT,          KPM_LT3 KPM_RT1,                 COMBO_LAYERS)
COMBO(rbkt,           &kp RBKT,          KPM_RT3 KPM_RT1,                 COMBO_LAYERS)
COMBO(lbrc,           &kp LBRC,          KPM_LT3 KPM_LM2,                 COMBO_LAYERS)
COMBO(rbrc,           &kp RBRC,          KPM_RT3 KPM_RM2,                 COMBO_LAYERS)

// Maths Symbols
COMBO(minus,          &kp MINUS,         KPM_RB1 KPM_RB2,                 COMBO_LAYERS)
COMBO(underscore,     &kp UNDERSCORE,    KPM_RB2 KPM_RB3,                 COMBO_LAYERS)
COMBO(equal,          &kp EQUAL,         KPM_RB1 KPM_RB3,                 COMBO_LAYERS)
COMBO(plus,           &kp PLUS,          KPM_RB1 KPM_RB2 KPM_RM3,         COMBO_LAYERS)
COMBO(less_than,      &kp LT,            KPM_RM1 KPM_RT2,                 COMBO_LAYERS)
COMBO(greater_than,   &kp GT,            KPM_RM3 KPM_RT2,                 COMBO_LAYERS)

// Shell Redirection
COMBO(pipe,           &kp PIPE,          KPM_RM1 KPM_RB1,                 COMBO_LAYERS)
COMBO(fslh,           &kp FSLH,          KPM_RB1 KPM_RM2,                 COMBO_LAYERS)
COMBO(bslh,           &kp BSLH,          KPM_RM2 KPM_RB3,                 COMBO_LAYERS)

// Shell Symbols
COMBO(grave,          &kp GRAVE,         KPM_LM1 KPM_LB2,                 COMBO_LAYERS)
COMBO(tilde,          &kp TILDE,         KPM_LB1 KPM_LM4,                 COMBO_LAYERS)

// Quotes & Punctuations
COMBO(colon,          &kp COLON,         KPM_RM1 KPM_RM2,                 COMBO_LAYERS)
COMBO(semicolon,      &kp SEMICOLON,     KPM_RM1 KPM_RM2 KPM_RM3,         COMBO_LAYERS)
COMBO(sqt_apos,       &kp SQT,           KPM_RM2 KPM_RM3,                 COMBO_LAYERS)
COMBO(dqt,            &kp DQT,           KPM_RM1 KPM_RM3,                 COMBO_LAYERS)

// Symbols
COMBO(qmark,          &kp QMARK,         KPM_LM2 KPM_LM3 KPM_RT2 KPM_RT3, COMBO_LAYERS)
COMBO(exclamation,    &kp EXCL,          KPM_RM2 KPM_RM3 KPM_LT2 KPM_LT3, COMBO_LAYERS)
COMBO(at,             &kp AT,            KPM_LM3 KPM_LT2,                 COMBO_LAYERS)
COMBO(hash,           &kp HASH,          KPM_LM3 KPM_LT1,                 COMBO_LAYERS)
COMBO(dollar,         &kp DOLLAR,        KPM_LM3 KPM_LB1,                 COMBO_LAYERS)
COMBO(percent,        &kp PERCENT,       KPM_RB1 KPM_RM3,                 COMBO_LAYERS)
COMBO(caret,          &kp CARET,         KPM_LM2 KPM_LB1,                 COMBO_LAYERS)
COMBO(ampersand,      &kp AMPS,          KPM_LT2 KPM_LM3,                 COMBO_LAYERS)
COMBO(asterisk,       &kp ASTRK,         KPM_RT1 KPM_RT2,                 COMBO_LAYERS)

// System - Vim
COMBO(esc,            &kp ESC,           KPM_LT2 KPM_LT1,                 COMBO_LAYERS)
COMBO(tab,            &kp TAB,           KPM_RT2 KPM_RT1,                 COMBO_LAYERS)
COMBO(enter,          &kp ENTER,         KPM_LB2 KPM_LB1,                 COMBO_LAYERS)
COMBO(enter_cross,    &kp ENTER,         KPM_LM1 KPM_RM1,                 COMBO_LAYERS)
COMBO(enter_thumb,    &kp ENTER,         KPM_LH0 KPM_RH0,                 COMBO_LAYERS)

// Modifiers
COMBO(lsft,           &skq LSHFT,        KPM_LM3 KPM_LM2,                 COMBO_LAYERS)
COMBO(caps_word,      &caps_word,        KPM_LT3 KPM_LT2,                 COMBO_LAYERS)
COMBO(lctrl,          &skq LCTRL,        KPM_LM3 KPM_LM1,                 COMBO_LAYERS)
COMBO(lalt,           &skq LALT,         KPM_LB3 KPM_LB4,                 COMBO_LAYERS)
COMBO(lgui,           &skq LGUI,         KPM_LM4 KPM_LB4,                 COMBO_LAYERS)

// Utility
COMBO(word_del,       &kp LS(BSPC),      KPM_RT2 KPM_RT3,                 COMBO_LAYERS)

// Repeat
COMBO(repeat,         &key_repeat,       KPM_LB3 KPM_LB2,                 COMBO_LAYERS)

// Nav
COMBO(up,             &kp UP,            KPM_LB4 KPM_LT2,                 COMBO_LAYERS)
COMBO(down,           &kp DOWN,          KPM_LB4 KPM_LM2,                 COMBO_LAYERS)
COMBO(left,           &kp LEFT,          KPM_LB4 KPM_LM3,                 COMBO_LAYERS)
COMBO(right,          &kp RIGHT,         KPM_LB4 KPM_LM1,                 COMBO_LAYERS)

// Remains...
COMBO(space_fg,       &kp SPACE,         KPM_LM1 KPM_LM0,                 COMBO_LAYERS)

    };
};
