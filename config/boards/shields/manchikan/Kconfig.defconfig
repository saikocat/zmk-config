## config/boards/shields/manchikan/Kconfig.defconfig
```kconfig
# Copyright 2022 saikocat (@saikocat)
# SPDX-License-Identifier: MIT

if SHIELD_MANCHIKAN_LEFT

    config ZMK_KEYBOARD_NAME
        default "Manchikan"

    config ZMK_SPLIT_ROLE_CENTRAL
        default y

    config ZMK_SPLIT_BLE_ROLE_CENTRAL
        default y

endif # LEFT




if SHIELD_MANCHIKAN_LEFT || SHIELD_MANCHIKAN_RIGHT

    config ZMK_SPLIT
        default y

endif # LEFT RIGHT
```

## config/boards/shields/manchikan/Kconfig.shield
```kconfig
# Copyright 2022 saikocat (@saikocat)
# SPDX-License-Identifier: MIT

config SHIELD_MANCHIKAN_LEFT
    def_bool $(shields_list_contains,manchikan_left)

config SHIELD_MANCHIKAN_RIGHT
    def_bool $(shields_list_contains,manchikan_right)
```

## config/boards/shields/settings_reset/Kconfig.defconfig
```kconfig
# Copyright 2022 saikocat (@saikocat)
# SPDX-License-Identifier: MIT

if SHIELD_SETTINGS_RESET_XIAO

    config ZMK_KEYBOARD_NAME
        default "Settings Reset"

endif
```

## config/boards/shields/settings_reset/Kconfig.shield
```kconfig
# Copyright 2022 saikocat (@saikocat)
# SPDX-License-Identifier: MIT

config SHIELD_SETTINGS_RESET_XIAO
    def_bool $(shields_list_contains,settings_reset_xiao)
```

## config/west.yml
```yaml
manifest:
  remotes:
    - name: zmkfirmware
      url-base: https://github.com/zmkfirmware
    - name: caksoylar
      url-base: https://github.com/caksoylar
  projects:
    - name: zmk
      remote: zmkfirmware
      revision: main
      import: app/west.yml

    # ZMK Extra Modules
    - name: zmk-rgbled-widget
      remote: caksoylar
      revision: main
    - name: zmk-smart-toggle
      remote: caksoylar
      revision: main
  self:
    path: config
```
