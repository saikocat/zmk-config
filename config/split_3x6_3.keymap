// Copyright 2023 saikocat (@saikocat)
// SPDX-License-Identifier: MIT

// TODO: BROKEN - DO NOT USE

#include <behaviors.dtsi>
#include <dt-bindings/zmk/keys.h>
#include <dt-bindings/zmk/bt.h>

#define COMBO_LAYERS _QWERTY _COLEMAK_DH _NAV _NUMPAD

#include "userspace/keymaps.h"
#include "userspace/keypos_morph/keypos_36keys.h"
#include "userspace/matrix_transforms.dtsi"
#include "userspace/behaviors.dtsi"
#include "userspace/combos.dtsi"

#if (__has_include("local_combos.dtsi"))
    #include "local_combos.dtsi"
#endif

/ {
    chosen {
        zmk,matrix_transform = &six_columns_42keys_stacked_transform;
    };

    keymap {
        compatible = "zmk,keymap";

LAYER(qwerty,
    &kp TAB   &kp Q    &kp W    &kp E       &kp R      &kp T
    &kp LCTL  &kp A    &kp S    &kp D       &kp F      &kp G
    &skq LALT &kp Z    &kp X    &kp C       &kp V      &kp B
                                &lt DEL_LWR  &lt BSPC_NUM  &td_omss_caps
    &kp Y    &kp U    &kp I       &kp O      &kp P     &kp BSPC
    &kp H    &kp J    &kp K       &kp L      &kp SEMI  &kp SQT
    &kp N    &kp M    &kp COMMA   &kp DOT    &kp FSLH  &mt LSHFT ENTER
    &lt ENT_ADJ  &kp SPACE  &lt TAB_RSE
)

LAYER(colemak_dh,
    &kp TAB   &kp Q    &kp W    &kp F       &kp P      &kp B
    &kp LCTL  &kp A    &kp R    &kp S       &kp T      &kp G
    &skq LALT &kp Z    &kp X    &kp C       &kp D      &kp V
                                &lt DEL_LWR  &lt BSPC_NUM  &td_omss_caps
    &kp J    &kp L    &kp U       &kp Y      &kp SEMI
    &kp M    &kp N    &kp E       &kp I      &kp O
    &kp K    &kp H    &kp COMMA   &kp DOT    &kp FSLH
    &lt ENT_ADJ  &kp SPACE  &lt TAB_RSE
)

LAYER(game_overwatch,
    ____     &kp TAB   &kp Q   &kp W    &kp E       &kp R
    ____     &kp LCTL  &kp A   &kp S    &kp D       &kp F
    ____     &kp LSHFT &kp Z   &kp X    &kp C       &kp V
                       &mo _GAME_NUMPAD  &kp SPACE  &mt LALT ESC
    ____     ____     ____     ____     ____     ____
    ____     ____     ____     ____     ____     ____
    ____     ____     ____     ____     ____     ____
    ____     ____     &mo _RAISE
)

LAYER(game_numpad,
    ____    &kp LC(N3)    &kp LC(N2)    &kp LC(N1)    &kp LC(N0)    &kp LC(N4)
    ____    &kp N3        &kp N2        &kp N1        &kp N0        &kp N4
    ____    &kp F3        &kp F2        &kp F1        &kp F5        &kp F4
                                ____          ____          ____
    ____     ____     ____     ____     ____     ____
    ____     ____     ____     ____     ____     ____
    ____     ____     ____     ____     ____     ____
    ____     ____     &mo _RAISE
)

LAYER(lower,
    ____     ____           &kp LC(W)       &kt LALT          &caps_word     &kp LG(SPACE)
    ____     &kp LC(LEFT)   &kp LC(RIGHT)   &kp LC(LS(TAB))   &kp LC(TAB)    ____
    ____     &kp LC(Z)      &kp LC(X)       &kp LC(C)         &kp LA(ESC)    &kp LC(V)
                                                           ____     ____     ____
    ____     ____     ____     ____     ____     ____
    ____     ____     ____     ____     ____     ____
    ____     ____     ____     ____     ____     ____
    ____     ____     &mo _ADJUST
)

LAYER(raise,
    ____     ____            ____        &kp UP      ____         ____
    ____     &kp LS(LEFT)    &kp LEFT    &kp DOWN    &kp RIGHT    &kp LS(RIGHT)
    ____     ____            ____        ____        ____         ____
                                         &mo _SPECIAL    ____     ____
    &tog _QWERTY   &tog _COLEMAK_DH  &tog _RAISE  &tog _GAME_OVERWATCH   &kp PSCRN    ____
    &kp LEFT       &kp DOWN          &kp UP       &kp RIGHT              &kp INS      ____
    &kp HOME       &kp PG_DN         &kp PG_UP    &kp END                ____         ____
    ____           ____              ____

)

LAYER(numpad,
    ____     ____     ____     ____     ____     ____
    ____     ____     ____     ____     ____     ____
    ____     ____     ____     ____     ____     ____
                               ____     ____     ____
    &kp KP_MULTIPLY    &kp N7    &kp N8    &kp N9    &kp KP_EQUAL     ____
    &kp N0             &kp N4    &kp N5    &kp N6    &kp KP_PLUS      ____
    &kp KP_DIVIDE      &kp N1    &kp N2    &kp N3    &kp KP_MINUS     ____
    &kp ENTER          &kp N0    &kp KP_DOT
)

LAYER(func,
    ____     ____     ____     ____     ____     ____
    ____     ____     ____     ____     ____     ____
    ____     ____     ____     ____     ____     ____
                               ____     ____     ____
    ____     &kp F7   &kp F8   &kp F9   &kp F10  ____
    ____     &kp F4   &kp F5   &kp F6   &kp F11  ____
    ____     &kp F1   &kp F2   &kp F3   &kp F12  ____
    ____     ____     ____
)

LAYER(special,
    XXXX     &bootloader   &sys_reset    XXXX         XXXX         XXXX
    XXXX     &bt BT_CLR    XXXX          &bt BT_PRV   &bt BT_NXT   XXXX
    XXXX     XXXX          &bt BT_SEL 2  &bt BT_SEL 1 &bt BT_SEL 0 XXXX
                                         XXXX         XXXX         XXXX
    XXXX     XXXX     XXXX     XXXX     XXXX     XXXX
    XXXX     XXXX     XXXX     XXXX     XXXX     XXXX
    XXXX     XXXX     XXXX     XXXX     XXXX     XXXX
    XXXX     XXXX     XXXX
)
    };
};
