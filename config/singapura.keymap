// Copyright 2023 saikocat (@saikocat)
// SPDX-License-Identifier: MIT

#include <behaviors.dtsi>
#include <dt-bindings/zmk/keys.h>
#include <dt-bindings/zmk/bt.h>
#include <dt-bindings/zmk/ext_power.h>

#include "userspace/nice_view.h"
OVERRIDE_NICEVIEW_CS(&pro_micro, 10)

#define COMBO_LAYERS _QWERTY _COLEMAK_DH _NAV _NUMPAD
#define KEYPOS_MORPH "userspace/keypos_morph/keypos_split_3x5_3_stacked.h"
#define LAYOUT_USER_TRANSFORM LAYOUT_3X5_3_STACKED_TRANSFORM
#define LAYOUT_LAYERS "userspace/layer/split_3x5_3_stacked.dtsi"

#include "keymap_common.h"

// Custom layout transform
&layout_user_transform LAYOUT_USER_TRANSFORM

/ {
    chosen {
        zmk,matrix_transform = &layout_user_transform;
    };

    keymap {
        compatible = "zmk,keymap";
        #include LAYOUT_LAYERS
    };
};

// vim: ft=dts et
